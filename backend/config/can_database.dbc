VERSION ""

NS_ :

BS_:

BU_:

BO_ 0 EXAMPLE: 8 Vector__XXX
 SG_ Signal1 : 0|16@1+ (1,0) [0|0] "" Vector__XXX
